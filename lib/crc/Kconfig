## lib/crc/Kconfig
```kconfig
# SPDX-License-Identifier: GPL-2.0-only

# Kconfig for the kernel's cyclic redundancy check (CRC) library code

config CRC4
	tristate
	help
	  The CRC4 library functions.  Select this if your module uses any of
	  the functions from <linux/crc4.h>.

config CRC7
	tristate
	help
	  The CRC7 library functions.  Select this if your module uses any of
	  the functions from <linux/crc7.h>.

config CRC8
	tristate
	help
	  The CRC8 library functions.  Select this if your module uses any of
	  the functions from <linux/crc8.h>.

config CRC16
	tristate
	help
	  The CRC16 library functions.  Select this if your module uses any of
	  the functions from <linux/crc16.h>.

config CRC16_RUST
	bool "Rust implementation of CRC-16 (Ferret)"
	depends on RUST
	# CRC16 has no prompt either; select it to force =y (see CRC_CCITT_RUST).
	select CRC16
	help
	  Build the CRC-16 library functions from the Rust implementation in
	  lib/crc/crc16_rust.rs instead of the C implementation in
	  lib/crc/crc16.c.

	  This is a Ferret migration experiment: it requires CRC16 to be
	  built-in (not modular) and is only enabled by test kernels for now.
	  The C implementation is kept in the tree as the reference used by
	  the differential KUnit test.

	  If unsure, say N.

config CRC16_DIFF_KUNIT_TEST
	bool "Differential KUnit test: CRC-16 C reference vs Rust"
	depends on CRC16_RUST
	depends on KUNIT
	help
	  Compile the original C implementation of CRC-16 under a test-only
	  symbol and compare it against the Rust implementation over edge
	  cases and randomised buffers.

	  This is test-only code; it is never part of a production kernel.

config CRC_CCITT
	tristate
	help
	  The CRC-CCITT library functions.  Select this if your module uses any
	  of the functions from <linux/crc-ccitt.h>.

config CRC_CCITT_RUST
	bool "Rust implementation of CRC-CCITT (Ferret)"
	depends on RUST
	# CRC_CCITT has no prompt: it is only ever enabled by select. Selecting it
	# here forces it to =y, which the Rust implementation requires (a built-in
	# Rust object cannot replace a modular C object).
	select CRC_CCITT
	help
	  Build the CRC-CCITT library functions and the exported
	  crc_ccitt_table[] from the Rust implementation in
	  lib/crc/crc_ccitt_rust.rs instead of the C implementation in
	  lib/crc/crc-ccitt.c.

	  This is a Ferret migration experiment: it requires CRC_CCITT to be
	  built-in (not modular) and is only enabled by test kernels for now.
	  The C implementation is kept in the tree as the reference used by the
	  differential KUnit test.

	  If unsure, say N.

config CRC_CCITT_DIFF_KUNIT_TEST
	bool "Differential KUnit test: CRC-CCITT C reference vs Rust"
	depends on CRC_CCITT_RUST
	depends on KUNIT
	help
	  Compile the original C implementation of CRC-CCITT under test-only
	  symbols and compare it against the Rust implementation and its
	  generated table over edge cases and randomised buffers.

	  This is test-only code; it is never part of a production kernel.

config CRC_ITU_T
	tristate
	help
	  The CRC-ITU-T library functions.  Select this if your module uses
	  any of the functions from <linux/crc-itu-t.h>.

config CRC_T10DIF
	tristate
	help
	  The CRC-T10DIF library functions.  Select this if your module uses
	  any of the functions from <linux/crc-t10dif.h>.

config CRC_T10DIF_ARCH
	bool
	depends on CRC_T10DIF && CRC_OPTIMIZATIONS
	default y if ARM && KERNEL_MODE_NEON
	default y if ARM64 && KERNEL_MODE_NEON
	default y if PPC64 && ALTIVEC
	default y if RISCV && RISCV_ISA_ZBC
	default y if X86

config CRC32
	tristate
	select BITREVERSE
	help
	  The CRC32 library functions.  Select this if your module uses any of
	  the functions from <linux/crc32.h> or <linux/crc32c.h>.

config CRC32_ARCH
	bool
	depends on CRC32 && CRC_OPTIMIZATIONS
	default y if ARM && KERNEL_MODE_NEON
	default y if ARM64
	default y if LOONGARCH
	default y if MIPS && CPU_MIPSR6
	default y if PPC64 && ALTIVEC
	default y if RISCV && RISCV_ISA_ZBC
	default y if S390
	default y if SPARC64
	default y if X86

config CRC64
	tristate
	help
	  The CRC64 library functions.  Select this if your module uses any of
	  the functions from <linux/crc64.h>.

config CRC64_ARCH
	bool
	depends on CRC64 && CRC_OPTIMIZATIONS
	default y if RISCV && RISCV_ISA_ZBC && 64BIT
	default y if X86_64

config CRC_OPTIMIZATIONS
	bool "Enable optimized CRC implementations" if EXPERT
	depends on !UML
	default y
	help
	  Disabling this option reduces code size slightly by disabling the
	  architecture-optimized implementations of any CRC variants that are
	  enabled.  CRC checksumming performance may get much slower.

	  Keep this enabled unless you're really trying to minimize the size of
	  the kernel.

config CRC_KUNIT_TEST
	tristate "KUnit tests for CRC functions" if !KUNIT_ALL_TESTS
	depends on KUNIT && (CRC7 || CRC16 || CRC_T10DIF || CRC32 || CRC64)
	default KUNIT_ALL_TESTS
	help
	  Unit tests for the CRC library functions.

	  This is intended to help people writing architecture-specific
	  optimized versions.  If unsure, say N.

config CRC_ENABLE_ALL_FOR_KUNIT
	tristate "Enable all CRC functions for KUnit test"
	depends on KUNIT
	select CRC7
	select CRC16
	select CRC_T10DIF
	select CRC32
	select CRC64
	help
	  Enable all CRC functions that have test code in CRC_KUNIT_TEST.

	  Enable this only if you'd like the CRC KUnit test suite to test all
	  the CRC variants, even ones that wouldn't otherwise need to be built.

config CRC_BENCHMARK
	bool "Benchmark for the CRC functions"
	depends on CRC_KUNIT_TEST
	help
	  Include benchmarks in the KUnit test suite for the CRC functions.
```
